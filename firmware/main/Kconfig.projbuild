## firmware/main/Kconfig.projbuild
```kconfig
menu "Cast online"
config CAST_WIFI_PORTAL
    bool "Runtime Wi-Fi and update service setup"
    default y
config CAST_BASE_URL
    string "Read-only lineup server base URL (no trailing slash)"
    default ""
    help
        Default service origin when no runtime origin is saved. Empty keeps
        updates unconfigured until an origin is saved. Hotspot connection may
        be configured separately. No Wi-Fi credentials are embedded; requests
        for lineup updates are made manually.
endmenu
```
